## conf/layer.conf
```bitbake
# We have a conf and classes directory, append to BBPATH
BBPATH .= ":${LAYERDIR}"

# We have a recipes directory containing .bb and .bbappend files, add to BBFILES
BBFILES += "${LAYERDIR}/recipes*/*/*.bb \
            ${LAYERDIR}/recipes*/*/*.bbappend"

BBFILE_COLLECTIONS += "itcam"
BBFILE_PATTERN_itcam := "^${LAYERDIR}/"
BBFILE_PRIORITY_itcam = "9"

LAYERVERSION_itcam = "1"
```
